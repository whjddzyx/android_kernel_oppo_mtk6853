## 4.14.186/drivers/misc/vendor/oplus/kernel/touchpanel/oplus_touchscreen/Synaptics/Kconfig
```kconfig
source "drivers/input/touchscreen/oplus_touchscreen/Synaptics/Syna_tcm_oncell/Kconfig"
source "drivers/input/touchscreen/oplus_touchscreen/Synaptics/TD4160/Kconfig"
```

## vendor/oplus/kernel/touchpanel/oplus_touchscreen/Himax/Kconfig
```kconfig
source "drivers/input/touchscreen/oplus_touchscreen/Himax/hx83102d_noflash/Kconfig"
source "drivers/input/touchscreen/oplus_touchscreen/Himax/hx83112f_noflash/Kconfig"
```
